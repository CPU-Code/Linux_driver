/*
 * @Author: cpu_code
 * @Date: 2020-05-19 20:25:44
 * @LastEditTime: 2020-05-20 10:13:45
 * @FilePath: \Linux_driver\5dtsled\dtsled.dts
 * @Gitee: https://gitee.com/cpu_code
 * @CSDN: https://blog.csdn.net/qq_44226094
 */ 

#include "xxx.dtsi"

//make dtbs，编译完成以后得到 dtsled.dtb，使用新的 dtb 启动Linux 内核

/ {
    dtsled
    {
        #address-cells = <1>;
        #size-cells = <0>;

        compatible = "dts-led";
        status = "okay";

        reg = < 0X020C406C 0X04     /* CCM_CCGR1_BASE */
                0X020E0068 0X04     /* SW_MUX_GPIO1_IO03_BASE */
                0X020E02F4 0X04     /* SW_PAD_GPIO1_IO03_BASE */
                0X0209C000 0X04     /* GPIO1_DR_BASE */
                0X0209C004 0X04 >;  /* GPIO1_GDIR_BASE */
    };
};